
// -----------------------------------------------
//
// my program here
//
// -----------------------------------------------
#include <Adafruit_GFX.h>    // Core graphics library
#include <Adafruit_ST7735.h> // Hardware-specific library
#include <SPI.h>
#include <ESP8266WiFi.h>
#include <WiFiClient.h>
// #include <ArduinoJson.h>

String answer;
String jsonAnswer;
// StaticJsonBuffer<200> jsonBuffer;
	
static const unsigned char PROGMEM Bitcoin48[] = {
0x00, 0x00, 0x00, 0x00, 0x00, 0x00, 0x00, 0x00, 0x00, 0x00, 0x00, 0x00, 0x00, 0x00, 0x00, 0x00,
0x00, 0x00, 0x00, 0x00, 0x00, 0x00, 0x00, 0x00, 0x00, 0x00, 0x00, 0x00, 0x00, 0x00, 0x00, 0x00,
0x0F, 0xF8, 0x00, 0x00, 0x00, 0x00, 0x7F, 0xFE, 0x00, 0x00, 0x00, 0x01, 0xFF, 0xFF, 0x80, 0x00,
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0x00, 0x00, 0x00, 0x00, 0x00, 0x00, 0x00, 0x00, 0x00, 0x00, 0x00, 0x00, 0x00, 0x00, 0x00, 0x00
};


#define TFT_CS     15
#define TFT_DC     2

Adafruit_ST7735 tft = Adafruit_ST7735(TFT_CS, TFT_DC);

const char* ssid = "*******";
const char* password = "*******";
const char* host = "api.coindesk.com";

int jsonIndex;

void setup()
{
  tft.initR(INITR_BLACKTAB);   
  tft.fillScreen(ST7735_BLACK);
  tft.setTextWrap(false);
  
  tft.setCursor(0, 10);
  tft.setTextSize(1);
  tft.println("Connecting to");
  tft.println(" ");
  tft.println(ssid);
  tft.println(" ");
   
  WiFi.begin(ssid, password);
  while (WiFi.status() != WL_CONNECTED)
  {
    delay(500);
    tft.print(".");
  }
  tft.println(" ");
  tft.println("==> connected");
}


void loop()
{
  WiFiClient client;

  // tft.printf("\n[Connecting to %s ... ", host);
  if (client.connect(host, 80))
  {
    // tft.println("connected]");

    // tft.println("[Sending a request]");
    client.print(String("GET /") + String("/v1/bpi/currentprice.json") + " HTTP/1.1\r\n" +
                 "Host: " + host + "\r\n" +
                 "Connection: close\r\n" +
                 "\r\n"
                );

    // tft.println("[Response:]");
	answer="";
    while (client.connected())
    {
      if (client.available())
      {
        String line = client.readStringUntil('\n');
        answer += line;
      }
    }
    client.stop();
    // tft.println("\n[Disconnected]");
 
    for (int i = 0; i < answer.length(); i++) { if (answer[i] == '{') { jsonIndex = i; break; }}
    jsonAnswer = answer.substring(jsonIndex);
    jsonAnswer.trim();

        int rateIndex = jsonAnswer.indexOf("rate_float");
        String priceString = jsonAnswer.substring(rateIndex + 12, rateIndex + 18);
        priceString.trim();
        float price = priceString.toFloat();

        tft.fillScreen(ST7735_BLACK);

		tft.drawBitmap(42,30,Bitcoin48,48,48,ST7735_GREEN);
		tft.setCursor(30, 80);
        tft.setTextSize(1);		
        tft.println("Bitcoin price: ");
		tft.setCursor(26, 93);
        tft.setTextSize(2);
        tft.println(price);
        tft.setTextSize(1);
  }
  else
  {
    tft.println("connection failed!]");
    client.stop();
  }
  delay(10000);
}


